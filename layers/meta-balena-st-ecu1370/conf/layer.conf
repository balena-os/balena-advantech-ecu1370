## layers/meta-balena-st-ecu1370/conf/layer.conf
```bitbake
BBPATH .= ":${LAYERDIR}"

BBFILES += "${LAYERDIR}/recipes-*/*/*.bb \
            ${LAYERDIR}/recipes-*/*/*.bbappend"

BBFILE_COLLECTIONS += "balena-st-ecu1370"
BBFILE_PATTERN_balena-st-ecu1370 := "^${LAYERDIR}/"
BBFILE_PRIORITY_balena-st-ecu1370 = "1337"

LAYERSERIES_COMPAT_balena-st-ecu1370 = " kirkstone"
LAYERSERIES_COMPAT_variscite-bsp = " kirkstone"
LAYERSERIES_COMPAT_freescale = " kirkstone"

# Mask recipes which we do not use and cause build failure
BBMASK .= " .*/meta-fsl-bsp-release/imx/meta-bsp/recipes-browser "
BBMASK .= " .*/meta-freescale/recipes-graphics"
BBMASK .= " .*/meta-freescale/dynamic-layers"
BBMASK .= " .*/meta-freescale/recipes-multimedia"
```
